#include "oled.h"
#include <string.h>

#define OLED_ADDR       0x78
#define OLED_CMD        0x00
#define OLED_DATA       0x40

static uint8_t oled_buffer[OLED_WIDTH * OLED_HEIGHT / 8];

static const uint8_t font6x8[][6] = {
    {0x00,0x00,0x00,0x00,0x00,0x00}, // ' '
    {0x00,0x00,0x5F,0x00,0x00,0x00}, // '!'
    {0x00,0x07,0x00,0x07,0x00,0x00}, // '"'
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    {0x08,0x08,0x2A,0x1C,0x08,0x00}, // '~'
};

static void OLED_WriteCmd(uint8_t cmd)
{
    uint8_t buf[2] = {OLED_CMD, cmd};
    HAL_I2C_Master_Transmit(&hi2c1, OLED_ADDR, buf, 2, 100);
}

static void OLED_WriteData(uint8_t data)
{
    uint8_t buf[2] = {OLED_DATA, data};
    HAL_I2C_Master_Transmit(&hi2c1, OLED_ADDR, buf, 2, 100);
}

void OLED_Init(void)
{
    HAL_Delay(100);

    OLED_WriteCmd(0xAE);
    OLED_WriteCmd(0x20);
    OLED_WriteCmd(0x10);
    OLED_WriteCmd(0xB0);
    OLED_WriteCmd(0xC8);
    OLED_WriteCmd(0x00);
    OLED_WriteCmd(0x10);
    OLED_WriteCmd(0x40);
    OLED_WriteCmd(0x81);
    OLED_WriteCmd(0xFF);
    OLED_WriteCmd(0xA1);
    OLED_WriteCmd(0xA6);
    OLED_WriteCmd(0xA8);
    OLED_WriteCmd(0x3F);
    OLED_WriteCmd(0xA4);
    OLED_WriteCmd(0xD3);
    OLED_WriteCmd(0x00);
    OLED_WriteCmd(0xD5);
    OLED_WriteCmd(0xF0);
    OLED_WriteCmd(0xD9);
    OLED_WriteCmd(0x22);
    OLED_WriteCmd(0xDA);
    OLED_WriteCmd(0x12);
    OLED_WriteCmd(0xDB);
    OLED_WriteCmd(0x20);
    OLED_WriteCmd(0x8D);
    OLED_WriteCmd(0x14);
    OLED_WriteCmd(0xAF);

    OLED_Clear();
    OLED_Refresh();
}

void OLED_Clear(void)
{
    memset(oled_buffer, 0x00, sizeof(oled_buffer));
}

void OLED_Refresh(void)
{
    for (uint8_t page = 0; page < 8; page++) {
        OLED_WriteCmd(0xB0 + page);
        OLED_WriteCmd(0x00);
        OLED_WriteCmd(0x10);

        uint8_t temp[OLED_WIDTH + 1];
        temp[0] = OLED_DATA;
        memcpy(&temp[1], &oled_buffer[page * OLED_WIDTH], OLED_WIDTH);
        HAL_I2C_Master_Transmit(&hi2c1, OLED_ADDR, temp, OLED_WIDTH + 1, 100);
    }
}

void OLED_DrawPixel(uint8_t x, uint8_t y, uint8_t color)
{
    if (x >= OLED_WIDTH || y >= OLED_HEIGHT) return;

    if (color) {
        oled_buffer[x + (y / 8) * OLED_WIDTH] |= (1 << (y % 8));
    } else {
        oled_buffer[x + (y / 8) * OLED_WIDTH] &= ~(1 << (y % 8));
    }
}

void OLED_DrawLine(uint8_t x1, uint8_t y1, uint8_t x2, uint8_t y2, uint8_t color)
{
    int16_t dx = (x2 > x1) ? (x2 - x1) : (x1 - x2);
    int16_t dy = (y2 > y1) ? (y2 - y1) : (y1 - y2);
    int16_t sx = (x1 < x2) ? 1 : -1;
    int16_t sy = (y1 < y2) ? 1 : -1;
    int16_t err = dx - dy;

    while (1) {
        OLED_DrawPixel(x1, y1, color);
        if (x1 == x2 && y1 == y2) break;
        int16_t e2 = 2 * err;
        if (e2 > -dy) {
            err -= dy;
            x1 += sx;
        }
        if (e2 < dx) {
            err += dx;
            y1 += sy;
        }
    }
}

void OLED_DrawRectangle(uint8_t x, uint8_t y, uint8_t w, uint8_t h, uint8_t color)
{
    for (uint8_t i = 0; i < w; i++) {
        OLED_DrawPixel(x + i, y, color);
        OLED_DrawPixel(x + i, y + h - 1, color);
    }
    for (uint8_t i = 0; i < h; i++) {
        OLED_DrawPixel(x, y + i, color);
        OLED_DrawPixel(x + w - 1, y + i, color);
    }
}

void OLED_DrawFilledRectangle(uint8_t x, uint8_t y, uint8_t w, uint8_t h, uint8_t color)
{
    for (uint8_t i = 0; i < w; i++) {
        for (uint8_t j = 0; j < h; j++) {
            OLED_DrawPixel(x + i, y + j, color);
        }
    }
}

void OLED_ShowChar(uint8_t x, uint8_t y, char chr, uint8_t color)
{
    if (x > OLED_WIDTH - 6 || y > OLED_HEIGHT - 8) return;
    if (chr < ' ' || chr > '~') chr = ' ';

    uint8_t idx = chr - ' ';
    for (uint8_t i = 0; i < 6; i++) {
        uint8_t line = font6x8[idx][i];
        for (uint8_t j = 0; j < 8; j++) {
            uint8_t pixel = (line >> j) & 0x01;
            OLED_DrawPixel(x + i, y + j, color ? pixel : !pixel);
        }
    }
}

void OLED_ShowString(uint8_t x, uint8_t y, const char *str, uint8_t color)
{
    while (*str) {
        OLED_ShowChar(x, y, *str++, color);
        x += 6;
        if (x > OLED_WIDTH - 6) {
            x = 0;
            y += 8;
        }
    }
}

void OLED_ShowNumber(uint8_t x, uint8_t y, int32_t num, uint8_t color)
{
    char buf[12];
    if (num < 0) {
        OLED_ShowChar(x, y, '-', color);
        x += 6;
        num = -num;
    }

    uint8_t i = 0;
    do {
        buf[i++] = (num % 10) + '0';
        num /= 10;
    } while (num > 0);

    while (i > 0) {
        OLED_ShowChar(x, y, buf[--i], color);
        x += 6;
    }
}
